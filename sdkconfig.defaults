## sdkconfig.defaults
```kconfig
# Enable HTTPS certificate bundle
CONFIG_MBEDTLS_CERTIFICATE_BUNDLE=y
CONFIG_MBEDTLS_CERTIFICATE_BUNDLE_DEFAULT_FULL=y

# Enable SNTP for time sync (required for cert validation)
CONFIG_LWIP_SNTP_UPDATE_DELAY=3600000

# Enable HTTPS
CONFIG_ESP_HTTP_CLIENT_ENABLE_HTTPS=y

# OTA Partition size (adjust if needed)
CONFIG_PARTITION_TABLE_CUSTOM=y
CONFIG_PARTITION_TABLE_CUSTOM_FILENAME="partitions.csv"
```
